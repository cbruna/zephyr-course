## app/Kconfig
```kconfig
menuconfig LED_SUBSYSTEM
    bool "LED Subsystem"
    default y

if LED_SUBSYSTEM

    choice
        prompt "LED blink sleep time"
        default BLINK_SLEEP_TIME_1000MS

        config BLINK_SLEEP_TIME_250MS
        bool "250ms (fast)"

        config BLINK_SLEEP_TIME_1000MS
        bool "1s (medium)"

        config BLINK_SLEEP_TIME_2000MS
        bool "2s (slow)"
    endchoice

    config BLINK_SLEEP_TIME_MS 
    int 
    default 250 if BLINK_SLEEP_TIME_250MS
    default 1000 if BLINK_SLEEP_TIME_1000MS
    default 2000 if BLINK_SLEEP_TIME_2000MS
    default 0

    
    menuconfig ADVANCED_LED_SETTINGS 
    bool "Advanced LED settings"
    
    if ADVANCED_LED_SETTINGS
    
        config LED_BRIGHTNESS
        int "LED brightness (0-100)"
        default 100
        range 0 100

        config LED_FADE_DURATION
        int "LED fade duration (ms)"
        default 500
        range 0 5000
  
    
    endif #ADVANCED_LED_SETTINGS

    menu "Expert settings"
        visible if ADVANCED_LED_SETTINGS
    
    config LED_DEBUG
    bool "Enable LED debugging"

    config CUSTOM_BLINK_PATTERN
    bool "Custom blink pattern"
    endmenu

endif #LED_SUBSYSTEM


menu "Zephyr config"
    source "Kconfig.zephyr"
endmenu
```
